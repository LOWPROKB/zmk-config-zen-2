/ {
  macros {
    /*
      Temporarily switches to a layer (&mo) while a modifier is held. This is
      an implementation of QMK's `LM()` using ZMK's parameterized macros.

      Params:
        1. Layer to switch to
        2. Modifier to press while layer is active

      Example:
        `&lm 1 LSHIFT`
     */
    lm: lm {
      label = "Layer Mod";
      wait-ms = <10>;
      tap-ms = <0>;
      compatible = "zmk,behavior-macro-two-param";
      #binding-cells = <2>;
      bindings = <&macro_param_2to1>,
        <&macro_press &sk MACRO_PLACEHOLDER>,
        <&macro_param_1to1>,
        <&macro_press &sl MACRO_PLACEHOLDER>,
        <&macro_pause_for_release>,
        <&macro_param_2to1>,
        <&macro_release &sk MACRO_PLACEHOLDER>,
        <&macro_param_1to1>,
        <&macro_release &sl MACRO_PLACEHOLDER>;
    };
  };
};
